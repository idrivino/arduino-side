///////////////////////////////////////////////////////////////////////////////////////////////////////////////////////
// 
// Copyright Nurve Networks LLC 2009
// 
// Filename: CHAM_AVR_SYSTEM_V010.c
//
// Original Author: Andre' LaMothe
// 
// Last Modified: 4.27.09
// 
// Description: This file contains generic defines, macros, types for all the library modules and system related 
// code and utility functions.
//
//
// 
//
//
///////////////////////////////////////////////////////////////////////////////////////////////////////////////////////

///////////////////////////////////////////////////////////////////////////////////////////////////////////////////////
// INCLUDES ///////////////////////////////////////////////////////////////////////////////////////////////////////////
///////////////////////////////////////////////////////////////////////////////////////////////////////////////////////

#include <stdint.h>
#include <stdio.h>
#include <stdlib.h>
#include <string.h>
#include <ctype.h>
#include <math.h>
#include <avr/eeprom.h>
#include <avr/io.h>
#include <avr/sleep.h>
#include <util/delay.h>
#include <avr/interrupt.h>
#include <avr/pgmspace.h>
#include <inttypes.h>
#include <compat/twi.h>
#include <avr/pgmspace.h>
#include <avr/wdt.h>

// include local CHAMELEON AVR API header files
#include "CHAM_AVR_SYSTEM_IDRIVINO_V0.h"
#include "CHAM_AVR_TWI_SPI_DRV_IDRIVINO_V0.h"

///////////////////////////////////////////////////////////////////////////////////////////////////////////////////////
// MACROS /////////////////////////////////////////////////////////////////////////////////////////////////////////////
///////////////////////////////////////////////////////////////////////////////////////////////////////////////////////


///////////////////////////////////////////////////////////////////////////////////////////////////////////////////////
// DEFINES/////////////////////////////////////////////////////////////////////////////////////////////////////////////
///////////////////////////////////////////////////////////////////////////////////////////////////////////////////////


///////////////////////////////////////////////////////////////////////////////////////////////////////////////////////
// TYPES/CLASSES //////////////////////////////////////////////////////////////////////////////////////////////////////
///////////////////////////////////////////////////////////////////////////////////////////////////////////////////////

///////////////////////////////////////////////////////////////////////////////////////////////////////////////////////
// GLOBALS ////////////////////////////////////////////////////////////////////////////////////////////////////////////
///////////////////////////////////////////////////////////////////////////////////////////////////////////////////////

unsigned long f_cpu = F_CPU;

///////////////////////////////////////////////////////////////////////////////////////////////////////////////////////
// EXTERNALS //////////////////////////////////////////////////////////////////////////////////////////////////////////
///////////////////////////////////////////////////////////////////////////////////////////////////////////////////////

///////////////////////////////////////////////////////////////////////////////////////////////////////////////////////
// PROTOTYPES /////////////////////////////////////////////////////////////////////////////////////////////////////////
///////////////////////////////////////////////////////////////////////////////////////////////////////////////////////

///////////////////////////////////////////////////////////////////////////////////////////////////////////////////////
// UTILITY FUNCTIONS //////////////////////////////////////////////////////////////////////////////////////////////////
///////////////////////////////////////////////////////////////////////////////////////////////////////////////////////

long atoi2(char *string)
{
// this function tries to convert the string to a number, supports binary %, hex $, decimal (default)
// Eg. %001010110, $EF, 25
int index = 0;
long sum = 0;
int ch;

// try to determine number base
if (string[index] == '$')
    {
    while ( (ch = string[++index]) != 0)
        sum = (sum << 4) + HEX_TO_DEC( toupper(ch) );
    return(sum);
    }
else
if (string[index] == '%')
    {
    while ( (ch = string[++index]) != 0)
        sum = (sum << 1) + (ch - '0');
    return(sum);
    } // end else if

else
    {
    // must be in default base, assume that
    return ( atol (string) );
    } // end else     

return(0);

} // end atoi2

///////////////////////////////////////////////////////////////////////////////////////////////////////////////////////

void Delay_Clocks(long count)
{
// rough function that assumes that each decrement and compare will take 6 clocks

count /= 6;

while ( count-- > 0);

} // end Delay_Clocks

///////////////////////////////////////////////////////////////////////////////////////////////////////////////////////

void _delay_s(int sec)
{
sec*=10;

while (sec-- > 0)
  _delay_ms(10000);

} // end _delay_s

/////////////////////////////////////////////////////////////////////////////////////////////////////////////////////////
// System reset and control
/////////////////////////////////////////////////////////////////////////////////////////////////////////////////////////

// Function Implementation
void wdt_init(void)
{
    // this function gets inserted into the init code with an earlier prototype declaration
    MCUSR = 0;
    wdt_disable();

    return;
}

int Reset_Prop(void)
{
// sends a "soft reset" to the Propeller

// reset the prop, hold onto your ass!
SPI_Prop_Send_Cmd( SYS_RESET, 0x00, 0x00);

// return success
return(1);

} // end Reset_Prop

/////////////////////////////////////////////////////////////////////////////////////////////////////////////////////////

int Reset_Master(void)
{
// resets the master chip (AVR/PIC) 

// reset the AVR
AVR_Soft_Reset();

// return success
return(1);

} // end Reset_Master

/////////////////////////////////////////////////////////////////////////////////////////////////////////////////////////
 
